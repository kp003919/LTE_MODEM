#include "lte_driver.h"
#include "lte_hw.h"
#include <string.h>
#include <stdint.h>

/* ----------------------------------------------------------
 * Configuration parameters for the LTE driver
 * ---------------------------------------------------------- */

#define LTE_EVENT_QUEUE_SIZE 16      // Size of the event queue
#define LTE_LINE_BUF_SIZE    256     // Buffer size for last received line

/* ----------------------------------------------------------
 * Event queue and last line storage
 * ---------------------------------------------------------- */

/*
 * s_events:
 *   Circular queue of events generated by the driver.
 *
 * s_head / s_tail:
 *   Indices into the circular queue.
 *   Queue is empty when s_head == s_tail.
 *
 * s_last_line:
 *   Stores the last complete line received from the modem.
 */
static LteEvent_t s_events[LTE_EVENT_QUEUE_SIZE];
static int        s_head = 0;
static int        s_tail = 0;
static char       s_last_line[LTE_LINE_BUF_SIZE];

/* ----------------------------------------------------------
 * RX buffer used by UART byte handler
 * ---------------------------------------------------------- */

/*
 * rx_buf / rx_pos:
 *   Temporary buffer used to accumulate characters until '\n'
 *   is received. Then the line is terminated and pushed as an
 *   LTE_EVENT_RX_LINE event.
 *
 * NOTE:
 *   These are file-scope so lte_driver_reset() can clear them.
 */
static char rx_buf[LTE_LINE_BUF_SIZE];
static int  rx_pos = 0;

/* ----------------------------------------------------------
 * Internal helper: push an event into the queue
 * ---------------------------------------------------------- */

/**
 * @brief Push an event into the queue.
 *
 * @note If the queue is full, the event is dropped.
 *
 * @param type Event type
 * @param line Pointer to the line (can be NULL)
 */
static void push_event(LteEventType_t type, const char *line)
{
    int next = (s_head + 1) % LTE_EVENT_QUEUE_SIZE;

    /* Check if there is space in the queue */
    if (next != s_tail) {
        s_events[s_head].type = type;
        s_events[s_head].line = line;
        s_head = next;
    }
    /* If full, event is silently dropped */
}

/* ----------------------------------------------------------
 * Public API: initialization and reset
 * ---------------------------------------------------------- */

/**
 * @brief Initialize the LTE driver.
 *
 * @note This is typically called once at startup.
 *       It clears the event queue and last line buffer.
 */
void lte_driver_init(void)
{
    s_head = 0;
    s_tail = 0;
    s_last_line[0] = '\0';

    rx_pos = 0;
    rx_buf[0] = '\0';
}

/**
 * @brief Reset the LTE driver for tests.
 *
 * @note This is used by unit tests to clear all internal
 *       state without reinitializing hardware/UART.
 *       It clears:
 *         - event queue
 *         - last line buffer
 *         - RX buffer and position
 */
void lte_driver_reset(void)
{
    /* Reset event queue indices */
    s_head = 0;
    s_tail = 0;

    /* Clear last line */
    s_last_line[0] = '\0';

    /* Clear RX buffer state */
    rx_pos = 0;
    rx_buf[0] = '\0';
}

/* ----------------------------------------------------------
 * Public API: event retrieval
 * ---------------------------------------------------------- */

/**
 * @brief Fetch next event from the queue.
 *
 * @param ev Pointer to LteEvent_t to fill.
 *
 * @return 1 if an event was returned, 0 if queue is empty.
 */
int lte_driver_get_next_event(LteEvent_t *ev)
{
    /* Check if the queue is empty */
    if (s_head == s_tail)
        return 0;

    /* Copy the event to the provided pointer */
    *ev = s_events[s_tail];
    s_tail = (s_tail + 1) % LTE_EVENT_QUEUE_SIZE;

    return 1;
}

/* ----------------------------------------------------------
 * Public API: send AT command
 * ---------------------------------------------------------- */

/**
 * @brief Send AT command to modem via UART.
 *
 * @param cmd Null-terminated command string.
 */
void lte_driver_send_cmd(const char *cmd)
{
    if (!cmd)
        return;

    lte_hw_uart_write(cmd);
}

/* ----------------------------------------------------------
 * Public API: last line helpers
 * ---------------------------------------------------------- */

/**
 * @brief Check if last line contains a substring.
 *
 * @param substr Substring to search for.
 *
 * @return non-zero if found, 0 otherwise.
 */
int lte_driver_last_line_contains(const char *substr)
{
    if (!substr)
        return 0;

    return strstr(s_last_line, substr) != NULL;
}

/**
 * @brief Check if last line starts with a prefix.
 *
 * @param prefix Prefix string.
 *
 * @return non-zero if it starts with prefix, 0 otherwise.
 */
int lte_driver_last_line_starts_with(const char *prefix)
{
    if (!prefix)
        return 0;

    size_t lp = strlen(prefix);
    return strncmp(s_last_line, prefix, lp) == 0;
}

/**
 * @brief Get pointer to last received line.
 *
 * @return const char* to internal buffer.
 */
const char *lte_driver_get_last_line(void)
{
    return s_last_line;
}

/* ----------------------------------------------------------
 * UART RX byte handler
 * ---------------------------------------------------------- */

/**
 * @brief Called from UART ISR via lte_hw when a byte is received.
 *
 * @param b Received byte.
 *
 * Behaviour:
 *   - Accumulates bytes into rx_buf until '\n' is seen.
 *   - On '\n', terminates the line, copies to s_last_line,
 *     and pushes LTE_EVENT_RX_LINE.
 *   - Ignores '\r'.
 */
void lte_driver_on_rx_byte(uint8_t b)
{
    if (b == '\n') {
        /* terminate line */
        rx_buf[rx_pos] = '\0';

        /* store as last line */
        strncpy(s_last_line, rx_buf, LTE_LINE_BUF_SIZE - 1);
        s_last_line[LTE_LINE_BUF_SIZE - 1] = '\0';

        /* push RX_LINE event */
        push_event(LTE_EVENT_RX_LINE, s_last_line);

        /* reset buffer */
        rx_pos = 0;
        rx_buf[0] = '\0';
    }
    else if (b != '\r') {
        if (rx_pos < LTE_LINE_BUF_SIZE - 1) {
            rx_buf[rx_pos++] = (char)b;
        }
        /* If buffer full, extra bytes are dropped */
    }
}

/* ----------------------------------------------------------
 * Optional: timeout / error hooks
 * ---------------------------------------------------------- */

/**
 * @brief Push a timeout event into the queue.
 */
void lte_driver_push_timeout_event(void)
{
    push_event(LTE_EVENT_TIMEOUT, NULL);
}

/**
 * @brief Push an error event into the queue.
 */
void lte_driver_push_error_event(void)
{
    push_event(LTE_EVENT_ERROR, NULL);
}
